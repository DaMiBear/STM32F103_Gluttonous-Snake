#include "OLED.h"
const unsigned char F6x8[][6] =		
{
0x00, 0x00, 0x00, 0x00, 0x00, 0x00,// sp
0x00, 0x00, 0x00, 0x2f, 0x00, 0x00,// !
0x00, 0x00, 0x07, 0x00, 0x07, 0x00,// "
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0x14, 0x14, 0x14, 0x14, 0x14, 0x14,// horiz lines
};
/****************************************8*16???************************************/
const unsigned char F8X16[]=	  
{
  0x00,0x00,0x00,0x00,0x00,0x00,0x00,0x00,0x00,0x00,0x00,0x00,0x00,0x00,0x00,0x00,// 0
  0x00,0x00,0x00,0xF8,0x00,0x00,0x00,0x00,0x00,0x00,0x00,0x33,0x30,0x00,0x00,0x00,//! 1
  0x00,0x10,0x0C,0x06,0x10,0x0C,0x06,0x00,0x00,0x00,0x00,0x00,0x00,0x00,0x00,0x00,//" 2
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  0x00,0x06,0x01,0x01,0x02,0x02,0x04,0x04,0x00,0x00,0x00,0x00,0x00,0x00,0x00,0x00,//~ 94
};
			
//

void delay(uint ms)
{
	uint x,y;
	for(x=ms;x>0;x--)
		for(y=150;y>0;y--);
}

//?????
//dc=1?????  dc=0?????
void OLED_Write_Byte(uint byte, uint dc)
{
	uint i;

	if(dc)								
	{
	  DC_HIGH;
	}
	else
	{
		DC_LOW;
	}
	CS_LOW;
	for(i = 0;i < 8;i++)
	{
		SCL_LOW;
		if(byte&0x80)
		{
			SI_HIGH;
		}
		else
		{
			SI_LOW;
		}
		SCL_HIGH;
		byte = byte<<1;
	}
	CS_HIGH;
}

/*oled??*/
void OLED_Clear(void)
{
	uint n,i;
	for(i = 0;i < 8;i++)
	{
		OLED_Write_Byte(0xb0+i,OLED_CMD);
		OLED_Write_Byte(0x00,OLED_CMD);
		OLED_Write_Byte(0x10,OLED_CMD);
		for(n = 0;n < 128;n++)
			OLED_Write_Byte(0,OLED_DATA);
	}
}

/*??OLED????*/
void OLED_Set_Pos(uint column,uint page)
{
	OLED_Write_Byte(0xb0+page,OLED_CMD);
	OLED_Write_Byte(((column&0xf0)>>4)|0x10,OLED_CMD);
	OLED_Write_Byte(column&0x0f,OLED_CMD);
}

//??OLED??    
void OLED_Display_On(void)
{
	OLED_Write_Byte(0X8D,OLED_CMD);  
	OLED_Write_Byte(0X14,OLED_CMD); 
	OLED_Write_Byte(0XAF,OLED_CMD);  
}

//??OLED??     
void OLED_Display_Off(void)
{
	OLED_Write_Byte(0X8D,OLED_CMD);  
	OLED_Write_Byte(0X10,OLED_CMD); 
	OLED_Write_Byte(0XAE,OLED_CMD);  
}	

/*????*/
void OLED_ShowChar(uint x,uint y,uint chr)
{      	
		uchar c=0,i=0;	
		c=chr-' ';//???????			
		if(x>Max_Column-1){x=0;y=y+2;}		//??128?
		if(SIZE ==16)
		{
			OLED_Set_Pos(x,y);	
			for(i=0;i<8;i++)
			OLED_Write_Byte(F8X16[c*16+i],OLED_DATA);
			OLED_Set_Pos(x,y+1);
			for(i=0;i<8;i++)
			OLED_Write_Byte(F8X16[c*16+i+8],OLED_DATA);
		}
		else 
		{	
			OLED_Set_Pos(x,y+1);
			for(i=0;i<6;i++)
			OLED_Write_Byte(F6x8[c][i],OLED_DATA);
		}
}
//m^n??
unsigned long oled_pow(uint m,uint n)
{
	unsigned long result=1;	 
	while(n--)result*=m;    
	return result;
}				  
//??2???
//x,y :????	 
//len :?????
//size:????
//mode:??	0,????;1,????
//num:??(0~4294967295);	 
void OLED_ShowNum(uchar x,uchar y,unsigned long num,uchar len,uchar size)
{         	
	uint t,temp;
	uint enshow=0;						   
	for(t=0;t<len;t++)
	{
		temp=(num/oled_pow(10,len-t-1))%10;
		if(enshow==0&&t<(len-1))
		{
			if(temp==0)
			{
				OLED_ShowChar(x+(size/2)*t,y,' ');
				continue;
			}else enshow=1; 
		 	 
		}
	 	OLED_ShowChar(x+(size/2)*t,y,temp+'0'); 
	}
}
/*?????*/
void OLED_ShowString(uchar x,uchar y,uchar *chr)
{
	unsigned char j=0;
	while (chr[j]!='\0')
	{		
		OLED_ShowChar(x,y,chr[j]);
		x+=8;
		if(x>120){x=0;y+=2;}
			j++;
	}
}


/*OLED???*/
void OLED_Init(void)
{
/*	SCL_OUT;
	SI_OUT;
	RES_OUT;
	DC_OUT;
	CS_OUT;*/
	GPIO_OLED();
	/*??? ??SCL?CS */
	SCL_HIGH;
	CS_HIGH;
	
	RES_HIGH;
	delay(100);
	RES_LOW;
	delay(100);
	RES_HIGH;

	OLED_Write_Byte(0xAE,OLED_CMD);//--turn off oled panel
	OLED_Write_Byte(0x02,OLED_CMD);//---set low column address
	OLED_Write_Byte(0x10,OLED_CMD);//---set high column address
	OLED_Write_Byte(0x40,OLED_CMD);//--set start line address  Set Mapping RAM Display Start Line (0x00~0x3F)
	OLED_Write_Byte(0x81,OLED_CMD);//--set contrast control register
	OLED_Write_Byte(0xCF,OLED_CMD); // Set SEG Output Current Brightness
	OLED_Write_Byte(0xA1,OLED_CMD);//--Set SEG/Column Mapping     0xa0???? 0xa1??
	OLED_Write_Byte(0xC8,OLED_CMD);//Set COM/Row Scan Direction   0xc0???? 0xc8??
	OLED_Write_Byte(0xA6,OLED_CMD);//--set normal display
	OLED_Write_Byte(0xA8,OLED_CMD);//--set multiplex ratio(1 to 64)
	OLED_Write_Byte(0x3f,OLED_CMD);//--1/64 duty
	OLED_Write_Byte(0xD3,OLED_CMD);//-set display offset	Shift Mapping RAM Counter (0x00~0x3F)
	OLED_Write_Byte(0x00,OLED_CMD);//-not offset
	OLED_Write_Byte(0xd5,OLED_CMD);//--set display clock divide ratio/oscillator frequency
	OLED_Write_Byte(0x80,OLED_CMD);//--set divide ratio, Set Clock as 100 Frames/Sec
	OLED_Write_Byte(0xD9,OLED_CMD);//--set pre-charge period
	OLED_Write_Byte(0xF1,OLED_CMD);//Set Pre-Charge as 15 Clocks & Discharge as 1 Clock
	OLED_Write_Byte(0xDA,OLED_CMD);//--set com pins hardware configuration
	OLED_Write_Byte(0x12,OLED_CMD);
	OLED_Write_Byte(0xDB,OLED_CMD);//--set vcomh
	OLED_Write_Byte(0x40,OLED_CMD);//Set VCOM Deselect Level
	OLED_Write_Byte(0x20,OLED_CMD);//-Set Page Addressing Mode (0x00/0x01/0x02)
	OLED_Write_Byte(0x02,OLED_CMD);//
	OLED_Write_Byte(0x8D,OLED_CMD);//--set Charge Pump enable/disable
	OLED_Write_Byte(0x14,OLED_CMD);//--set(0x10) disable
	OLED_Write_Byte(0xA4,OLED_CMD);// Disable Entire Display On (0xa4/0xa5)
	OLED_Write_Byte(0xA6,OLED_CMD);// Disable Inverse Display On (0xa6/a7) 
	OLED_Write_Byte(0xAF,OLED_CMD);//--turn on oled panel
	
	OLED_Write_Byte(0xAF,OLED_CMD); /*display ON*/ 
	OLED_Clear();
	OLED_Set_Pos(0,0);

}

void GPIO_OLED()
{
	
	GPIO_InitTypeDef GPIO_InitStruct; //结构体命名  
	RCC_APB2PeriphClockCmd(RCC_APB2Periph_GPIOA|RCC_APB2Periph_GPIOC,ENABLE);//使能B端口
	
	GPIO_InitStruct.GPIO_Mode=GPIO_Mode_Out_PP;         //推挽输出
	GPIO_InitStruct.GPIO_Pin=GPIO_Pin_4 | GPIO_Pin_5 | GPIO_Pin_6  | GPIO_Pin_7 ;							//选中引脚
	GPIO_InitStruct.GPIO_Speed=GPIO_Speed_50MHz;			//最高输出速率50Mhz
	GPIO_Init(GPIOA,&GPIO_InitStruct);          //初始化PB端口
	
	
	GPIO_InitStruct.GPIO_Mode=GPIO_Mode_Out_PP;         //推挽输出
	GPIO_InitStruct.GPIO_Pin=GPIO_Pin_4 | GPIO_Pin_2;		//包含了2104的SD端
	GPIO_InitStruct.GPIO_Speed=GPIO_Speed_50MHz;			//最高输出速率50Mhz
	GPIO_Init(GPIOC,&GPIO_InitStruct);          //初始化PB端口
}

